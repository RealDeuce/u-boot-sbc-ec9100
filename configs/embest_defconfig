## configs/embest_defconfig
```kconfig
CONFIG_SYS_EXTRA_OPTIONS="IMX_CONFIG=board/freescale/mx6ul_14x14_evk/imximage.cfg,MX6UL,MX6UL_EVK_EMMC_REWORK,BOOT_FROM_SD"
#CONFIG_IMX_CONFIG="board/freescale/mx6ul_14x14_evk/imximage.cfg"
CONFIG_TEXT_BASE=0x87800000
CONFIG_ARM=y
CONFIG_ARCH_MX6=y
CONFIG_MX6UL=y
CONFIG_MXC_UART=y
CONFIG_TARGET_MX6UL_14X14_EVK=y
CONFIG_DM=y
CONFIG_DM_THERMAL=y
CONFIG_OF_CONTROL=y
CONFIG_DEFAULT_DEVICE_TREE="embest_fsl_sbc_ec9100_4.3inch"
#CONFIG_DM_SERIAL=y
```
